## lib/modem_info/Kconfig
```kconfig
#
# Copyright (c) 2019 Nordic Semiconductor
#
# SPDX-License-Identifier: LicenseRef-BSD-5-Clause-Nordic
#

menuconfig MODEM_INFO
	bool "nRF91 modem information library"
	select BSD_LIBRARY
	select AT_CMD_PARSER

if MODEM_INFO

config MODEM_INFO_MAX_AT_PARAMS_RSP
	int "Maximum number of response parameters"
	default 8
	help
	  Set the maximum number of parameters the parser
	  will check for in any given string.

config MODEM_INFO_BUFFER_SIZE
	int "Size of buffer used to read data from the socket"
	default 128
	help
	  Set the size of the buffer that contains the returned
	  string after an AT command. The buffer is processed
	  through the parser.

config MODEM_INFO_ADD_NETWORK
	bool "Read the network information from the modem"
	default y
	help
	  Add the network information to the returned
	  device JSON object.

config MODEM_INFO_ADD_SIM
	bool "Read the SIM card information from the modem"
	default y
	help
	  Add the SIM card information to the returned
	  device JSON object.

config MODEM_INFO_ADD_SIM_ICCID
	bool "Read the SIM card ICCID from the modem"
	default y
	help
	  Add the SIM card ICCID to the returned
	  device JSON object.

config MODEM_INFO_ADD_DEVICE
	bool "Add the device information to the modem informer"
	default y
	help
	  Add the device information to the returned
	  device JSON object.

if MODEM_INFO_ADD_DEVICE

config MODEM_INFO_ADD_DEVICE_MODEM_FW
	bool "Add modem FW version" 
	default y

config MODEM_INFO_ADD_DEVICE_BATTERY
	bool "Add battery level" 
	default y

config MODEM_INFO_ADD_DEVICE_BOARD
	bool "Add board name" 
	default y

config MODEM_INFO_ADD_DEVICE_APP_VERSION
	bool "Add application version" 
	default y

config MODEM_INFO_ADD_DEVICE_APP_NAME
	bool "Add application name"
	default y

endif # MODEM_INFO_ADD_DEVICE

config MODEM_INFO_ADD_BOARD
	bool "Add board name to JSON string"
	default y
	help
	  Add the name of the board to the returned
	  device JSON object.

endif # MODEM_INFO
```
